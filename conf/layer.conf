## conf/layer.conf
```bitbake
BBPATH .= ":${LAYERDIR}"

BBFILES += "${LAYERDIR}/recipes*/*/*.bb ${LAYERDIR}/recipes*/*/*.bbappend"

BBFILE_COLLECTIONS += "meta-unit-apps"
BBFILE_PATTERN_meta-unit-apps := "^${LAYERDIR}/"
BBFILE_PRIORITY_meta-unit-apps = "13"

LAYERDEPENDS_meta-unit-apps = "core"

LAYERSERIES_COMPAT_meta-unit-apps = "walnascar"

BBFILES_DYNAMIC += " \
    flutter-layer:${LAYERDIR}/dynamic-layers/flutter-layer/*/*/*.bb \
    flutter-layer:${LAYERDIR}/dynamic-layers/flutter-layer/*/*/*.bbappend \
"
```
